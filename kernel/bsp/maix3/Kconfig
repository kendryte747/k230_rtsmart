## kernel/bsp/maix3/Kconfig
```kconfig
mainmenu "RT-Thread Project Configuration"

config BSP_DIR
    string
    option env="BSP_ROOT"
    default "."

config RTT_DIR
    string
    option env="RTT_ROOT"
    default "../../rt-thread"

config PKGS_DIR
   string
   option env="PKGS_ROOT"
   default "packages"

source "$RTT_DIR/Kconfig"

# we disable use online packages
# comment "Be Careful use RT-Smart Online Packages"
# source "$PKGS_DIR/Kconfig"

comment "Application Configure Start"

config USER_APP_DIR
    string "User Applications Directory"
    default "applications"

source "$USER_APP_DIR/Kconfig"

comment "K230 Custom Configure Start"

source "applications/Kconfig"
source "board/Kconfig"
source "drivers/Kconfig"
source "components/Kconfig"

source "testcase/kernel/Kconfig"

config CHIP_K230
    bool
    select ARCH_RISCV64
    select RT_USING_COMPONENTS_INIT
    select RT_USING_USER_MAIN
    select RT_USING_CACHE
	select ARCH_MM_MMU
    default y

config RT_USING_USERSPACE
    bool
    default y

config ENABLE_FPU
    bool "Enable FPU"
    default y

config ENABLE_VECTOR
    bool "Using RISC-V Vector Extension"
    default y

config __STACKSIZE__
    int "stack size for interrupt"
    default 4096

config RT_OPTIMIZE_LWP_LOAD
    def_bool y

config RT_VERSION_MAJOR
    int
    default 5

config RT_VERSION_MINOR
    int
    default 9

config RT_VERSION_PATCH
    int
    default 9
```

## kernel/bsp/maix3/app_canmv/Kconfig
```kconfig
menu "Applications CanMV Configuration"

    config RT_RECOVERY_MPY_AUTO_EXEC_PY
        bool "Enable recovery micropython auto execute boot.py or main.py make system crash"
        default y

endmenu
```

## kernel/bsp/maix3/applications/Kconfig
```kconfig
menu "Applications Configuration"

    source "applications/user/Kconfig"

endmenu
```

## kernel/bsp/maix3/applications/user/Kconfig
```kconfig
menuconfig RTT_ENABLE_USER_APP
    bool "Enable User Applications"
    default n

    if RTT_ENABLE_USER_APP


    endif
```
