## kernel/bsp/maix3/drivers/Kconfig
```kconfig
menu "Drivers Configuration"

    menu "InterDriver"
        config RT_USING_ADC
            bool "Using ADC device drivers"
            default n

        menuconfig RT_USING_CIPHER
            bool "Enable CIPHER"
            default n

            if RT_USING_CIPHER
                config RT_USING_AES
                    bool "Use HW AES accelerator"
                    default n
                config RT_USING_HASH
                    bool "Use HW SHA256 accelerator"
                    default n
                config RT_USING_SM4
                    bool "Use HW SM4 accelerator"
                    default n
            endif

        config RT_USING_GNNE
            bool "Enable GNNE driver for ai"
            default y

        config RT_USING_GPIO
            bool "Enable GPIO Driver"
            default n

        config RT_USING_HARDLOCK
            bool "Enable HardLock Driver"
            default n

        config RT_USING_PDMA
            bool "Enable PDMA Driver"
            default n

        menuconfig RT_USING_HWTIMER
            bool "Using hardware timer device drivers"
            default n
            
            if RT_USING_HWTIMER
                config RT_USING_HW_TIMER0
                    bool "Enable HW Timer0"
                    default n
                config RT_USING_HW_TIMER1
                    bool "Enable HW Timer1"
                    default n
                config RT_USING_HW_TIMER2
                    bool "Enable HW Timer2"
                    default n
                config RT_USING_HW_TIMER3
                    bool "Enable HW Timer3"
                    default n
                config RT_USING_HW_TIMER4
                    bool "Enable HW Timer4"
                    default n
                config RT_USING_HW_TIMER5
                    bool "Enable HW Timer5"
                    default n
            endif

        menuconfig RT_USING_I2C
            bool "Enable I2C"
            default n

            if RT_USING_I2C
                config RT_USING_SOFT_I2C
                    bool "Enable Soft I2C"
                    default n

                config RT_USING_I2C_SLAVE_EEPROM
                    bool "Enable I2C Slave Server as eeprom"
                    default n

                config RT_USING_I2C0
                    bool "Enable I2C0"
                    default n

                    if RT_USING_I2C0
                        config RT_USING_I2C0_SLAVE
                        bool "Enable I2C0 SLAVE mode"
                        select RT_USING_I2C_SLAVE_EEPROM
                        default n
                    endif
                config RT_USING_I2C1
                    bool "Enable I2C1"
                    default n

                    if RT_USING_I2C1
                        config RT_USING_I2C1_SLAVE
                        bool "Enable I2C1 SLAVE mode"
                        select RT_USING_I2C_SLAVE_EEPROM
                        default n
                    endif
                config RT_USING_I2C2
                    bool "Enable I2C2"
                    default n

                    if RT_USING_I2C2
                        config RT_USING_I2C2_SLAVE
                        bool "Enable I2C2 SLAVE mode"
                        select RT_USING_I2C_SLAVE_EEPROM
                        default n
                    endif
                config RT_USING_I2C3
                    bool "Enable I2C3"
                    default n

                    if RT_USING_I2C3
                        config RT_USING_I2C3_SLAVE
                        bool "Enable I2C3 SLAVE mode"
                        select RT_USING_I2C_SLAVE_EEPROM
                        default n
                    endif
                config RT_USING_I2C4
                    bool "Enable I2C4"
                    default n

                    if RT_USING_I2C4
                        config RT_USING_I2C4_SLAVE
                        bool "Enable I2C4 SLAVE mode"
                        select RT_USING_I2C_SLAVE_EEPROM
                        default n
                    endif
            endif

        menuconfig RT_USING_SPI
            bool "Enable SPI Driver"
            default n

            if RT_USING_SPI
                config RT_USING_SPI0
                    bool "Enable SPI0"
                    default n
                config RT_USING_SPI1
                    bool "Enable SPI1"
                    default n
                config RT_USING_SPI2
                    bool "Enable SPI2"
                    default n
            endif

        config RT_USING_PWM
            bool "Using PWM device drivers"
            default n

        config RT_USING_RTC_PMU
            bool "Using RTC device drivers"
            default n

        menuconfig RT_USING_SDIO
            bool "Enable SDIO Driver"
            default n

            if RT_USING_SDIO
                config RT_USING_SDIO0
                    bool "Enable SDIO0"
                    default n

                if RT_USING_SDIO0
                    config RT_SDIO0_EMMC
                        bool "SDIO0 device is eMMC"
                        default n
                    config RT_SDIO0_1V8
                        bool "SDIO0 device is 1.8V"
                        default n
                endif

                config RT_USING_SDIO1
                    bool "Enable SDIO1"
                    default n

                choice SDCARD_ON_SDIO_DEV
                    bool "SdCard is on SDIOx"

                    config SDCARD_ON_SDIO_DEV0
                        bool "SdCard is on SDIO0"

                    config SDCARD_ON_SDIO_DEV1
                        bool "SdCard is on SDIO1"
                endchoice

                config SDCARD_ON_SDIO_DEV
                    int 
                    default 0 if SDCARD_ON_SDIO_DEV0
                    default 1 if SDCARD_ON_SDIO_DEV1
            endif

            config RT_USING_SPI
                bool "Enable SPI1 device driver"
                default n

            menuconfig RT_USING_TS
                bool "Enable Tsensor driver"
                default n

                if RT_USING_TS

                    config DRV_TS_USE_RT_DEVICE
                        bool "Tsensor driver use RT Device framework"
                        default y

                endif
            
            menuconfig RT_USING_CANAAN_UART
                bool "Enable Uart Canaan device model driver"
                default n
                
                if RT_USING_CANAAN_UART
                    config RT_USING_UART_CANAAN_1
                        bool "Enable Uart Canaan device 1"
                        default n
                    config RT_USING_UART_CANAAN_2
                        bool "Enable Uart Canaan device 2"
                        default n
                    config RT_USING_UART_CANAAN_3
                        bool "Enable Uart Canaan device 3"
                        default n
                    config RT_USING_UART_CANAAN_4
                        bool "Enable Uart Canaan device 4"
                        default n

                    config CANAAN_UART_BUFFER_SIZE
                        int "Uart Canaan Buffer size in Bytes"
                        default 131072

                    config POLLIN_SIZE
                        int
                        default CANAAN_UART_BUFFER_SIZE/2

                    config UART_TIMEOUT
                        int "Uart Canaan Pool timeout"
                        default 1000
                endif

            config RT_USING_WDT
                bool "Using Watch Dog device drivers"
                default n
    endmenu

    menu "Ext Driver"
        menuconfig RT_USING_CYW43XX
            bool "Enable CYW43XX WiFi Driver"
            default n

            if RT_USING_CYW43XX
                choice CYW43XX_SDIO_DEV
                    bool "CYW43XX Wifi Use SDIO Device"

                    config CYW43XX_SDIO_DEV0
                        bool "Using SDIO0"
                    config CYW43XX_SDIO_DEV1
                        bool "Using SDIO1"
                endchoice

                config CYW43XX_SDIO_DEV
                    int
                    default 0 if CYW43XX_SDIO_DEV0
                    default 1 if CYW43XX_SDIO_DEV1

                config CYW43_PIN_WL_REG_ON
                    int "CYW43XX REG_ON Pin"
                    default 1

                config CYW43XX_THREAD_PRIORITY
                    int
                    default 10
                config CYW43XX_THREAD_STACK_SIZE
                    int
                    default 4096
            endif

        menuconfig RT_USING_EEPROM
            bool "Enable EEPROM over GPIO Driver"
            default n

            if RT_USING_EEPROM


            endif
            
        menuconfig RT_USING_REALTEK
            bool "Enable Realtek WiFi Driver"
            default n

            if RT_USING_REALTEK
                choice REALTEK_SDIO_DEV
                    bool "Realtek Wifi Use SDIO Device"

                    config REALTEK_SDIO_DEV0
                        bool "Using SDIO0"
                    config REALTEK_SDIO_DEV1
                        bool "Using SDIO1"
                endchoice

                config REALTEK_SDIO_DEV
                    int
                    default 0 if REALTEK_SDIO_DEV0
                    default 1 if REALTEK_SDIO_DEV1
            endif

        menuconfig RT_USING_REGULATOR
            bool "Enable regulator Driver"
            depends on RT_USING_PM
            default y

            if RT_USING_REGULATOR
                config RT_USING_REGULATOR_TPS6286X
                    bool "Use TPS6286X"
                    default n
            endif

        menuconfig RT_USING_TOUCH
            bool "Enable Touch Drive"

            if RT_USING_TOUCH
                choice TOUCH_DRV_MODEL
                    bool "Touch Drive Model"
                    default TOUCH_DRV_MODEL_INT_WITH_THREAD

                    config TOUCH_DRV_MODEL_POOL
                        bool "Pooling when user read"
                    config TOUCH_DRV_MODEL_INT_WITH_THREAD
                        bool "Device Int and Read in Thread"
                endchoice

                if TOUCH_DRV_MODEL_INT_WITH_THREAD
                    config TOUCH_DRV_THREAD_PRIO
                        int "Touch Thread Priority"
                        default 19
                    config TOUCH_DRV_THREAD_STACK_SIZE
                        int "Touch Thread Stack Size"
                        default 4096
                endif

                config TOUCH_DEV_INT_PIN
                    int "Touch Device INT Pin"
                    default -1

                choice TOUCH_DEV_INT_EDGE
                    bool "Touch Device INT Edge"
                    default TOUCH_DEV_INT_EDGE_FALLING

                    config TOUCH_DEV_INT_EDGE_RISING
                        bool "RISING"
                    config TOUCH_DEV_INT_EDGE_FALLING
                        bool "FALLING"
                    config TOUCH_DEV_INT_EDGE_BOTH
                        bool "BOTH"
                    config TOUCH_DEV_INT_EDGE_HIGH
                        bool "HIGH"
                    config TOUCH_DEV_INT_EDGE_LOW
                        bool "LOW"
                endchoice

                config TOUCH_DEV_INT_EDGE
                    int
                    default GPIO_PE_RISING if TOUCH_DEV_INT_EDGE_RISING
                    default GPIO_PE_FALLING if TOUCH_DEV_INT_EDGE_FALLING
                    default GPIO_PE_BOTH if TOUCH_DEV_INT_EDGE_BOTH
                    default GPIO_PE_HIGH if TOUCH_DEV_INT_EDGE_HIGH
                    default GPIO_PE_LOW if TOUCH_DEV_INT_EDGE_LOW

                config TOUCH_DEV_RST_PIN
                    int "Touch Device RST Pin"
                    default -1

                config TOUCH_DEV_RST_PIN_VALID_VALUE
                    int "Touch Device RST Pin Valid Value"
                    default 0

                config TOUCH_DEV_I2C_BUS
                    string "Touch Device I2C Bus Name"
                    default "i2c3"
                
                menuconfig TOUCH_DEV_I2C_SET_SPEED
                    bool "Touch Device Change I2C Speed"
                    default y

                    if TOUCH_DEV_I2C_SET_SPEED
                        config TOUCH_DEV_I2C_BUS_SPEED
                            int "Touch Device I2C Bus Speed"
                            default 400000
                    endif

                config TOUCH_RANGE_X
                    int "Touch Range X, Origin of Touch Output"
                    default 480

                config TOUCH_RANGE_Y
                    int "Touch Range Y, Origin of Touch Output"
                    default 800

                config TOUCH_POINT_NUM
                    int "Touch Point Number"
                    default 5

                config TOUCH_TYPE_FT5316
                    bool "Enable Touch FT5316"
                    default n

                config TOUCH_TYPE_CST128
                    bool "Enable Touch CST128 - FT5316 Compatible"
                    default n

                config TOUCH_TYPE_CHSC5XXX
                    bool "Enable Touch CHSC5xxx"
                    default n

                if TOUCH_TYPE_CHSC5XXX
                    config TOUCH_CHSC5XXX_MAX_POINTS
                        int "Maximum touch points supported by CHSC5xxx"
                        default 5
                endif
            endif

        menuconfig RT_USING_WS2812
            bool "Enable WS2812"
            default n

            if RT_USING_WS2812
                choice WS2812_USE_DRV
                    bool "WS2812 Use Drive mode"
                    default WS2812_USE_DRV_GPIO

                    config WS2812_USE_DRV_GPIO
                        bool "Using GPIO"
                    config WS2812_USE_DRV_I2S
                        bool "Using I2S"
                endchoice

                if WS2812_USE_DRV_GPIO
                    config WS2812_GPIO_PIN_NUM
                        int "WS2812 GPIO Output Pin"
                        default 35
                endif
            endif
    endmenu
endmenu
```
